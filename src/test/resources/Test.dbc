VERSION "TestVersion1"

NS_ :

BS_:

BU_: SendingNODE1 SendingNODE2

BO_ 1800 Msg1Txt: 8 SendingNODE1
 SG_ sg1 : 0|1@1+ (1,0) [0|1] "" Vector__XXX
 SG_ sg2 : 1|1@1+ (1,0) [0|1] "" Vector__XXX

BO_ 1801 Msg2Txt: 8 SendingNODE2
 SG_ sg3 : 0|2@1+ (1,0) [0|3] "" Vector__XXX

CM_ SG_ 1800 sg1 "Test1 Message";
CM_ BO_ 1800 "SendingNode1 Msg";
CM_ BO_ 1801 "SendingNode2 Msg";
CM_ SG_ 1801 sg3 "Test3 Message";
VAL_ 1800 sg1 0 "Test Value 1" 1 "Test Value 2"
VAL_ 1801 sg3 0 "Test Value Test 1" 1 "Test Value Test2" 2 "TestValue3" 3 "TestValue 4"
