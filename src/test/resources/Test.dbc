VERSION "TestVersion1"

NS_ :

BS_:

BU_: SendingNODE1 SendingNODE2

BO_ 1800 Msg1Txt: 8 SendingNODE1
 SG_ sg1 : 0|1@1+ (1,0) [0|1] "" Vector__XXX
 SG_ sg2 : 1|1@1+ (1,0) [0|1] "" Vector__XXX

BO_ 1801 Msg2Txt: 8 SendingNODE2
 SG_ sg3 : 0|2@1+ (1,0) [0|3] "" Vector__XXX
